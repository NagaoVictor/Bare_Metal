/dts-v1/;
/plugin/;

/ {
    compatible = "brcm,bcm2835";

    fragment@0 {
        target = <&gpio>;
        __overlay__ {
            ff_pins: ff_pins {
                brcm,pins = <17>;
                brcm,function = <0>; /* 0 = Input */
                brcm,pull = <2>;     /* 2 = Pull-Up interno ativado */
            };
        };
    };

    fragment@1 {
        target-path = "/";
        __overlay__ {
            flying_fish_node: flying_fish {
                compatible = "nagao,flying-fish";
                pinctrl-names = "default";
                pinctrl-0 = <&ff_pins>;
                sensor-gpios = <&gpio 17 1>;
                buzzer-gpios = <&gpio 27 0>;
                status = "okay";
            };
        };
    };
};
